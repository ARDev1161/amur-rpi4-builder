## meta-amur/conf/layer.conf
```bitbake
# We have a conf and classes directory, add to BBPATH
BBPATH .= ":${LAYERDIR}"

# We have recipes-* directories, add to BBFILES
BBFILES += "${LAYERDIR}/recipes-*/*/*.bb \
            ${LAYERDIR}/recipes-*/*/*.bbappend"

BBFILE_COLLECTIONS += "meta-amur"
BBFILE_PATTERN_meta-amur = "^${LAYERDIR}/"
BBFILE_PRIORITY_meta-amur = "6"

LAYERDEPENDS_meta-amur = "core"
LAYERSERIES_COMPAT_meta-amur = "scarthgap"
```
